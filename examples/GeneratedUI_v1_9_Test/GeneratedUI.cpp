// Generated by TJC_Studio v1.9.0
#include "GeneratedUI.h"

GeneratedUI_page0::GeneratedUI_page0(TJC_Display& lcd)
    : _lcd(lcd),
      title(lcd.text("tTitle", GeneratedUI_ID::Title)),
      value(lcd.number("nValue", GeneratedUI_ID::Value)),
      progress(lcd.progress("jProgress", GeneratedUI_ID::Progress)),
      start(lcd.button("bStart", GeneratedUI_ID::Start)),
      slider(lcd.slider("hSlider", GeneratedUI_ID::Slider)),
      bt0(lcd.dualButton("bt0", GeneratedUI_ID::Bt0))
{
}

void GeneratedUI_page0::show()
{
    _lcd.page(GeneratedUI_ID::Page0);
}

void GeneratedUI_page0::handleEvent(const TJC_Event& event)
{
    title.handleEvent(event);
    value.handleEvent(event);
    progress.handleEvent(event);
    start.handleEvent(event);
    slider.handleEvent(event);
    bt0.handleEvent(event);
}

GeneratedUI_page1::GeneratedUI_page1(TJC_Display& lcd)
    : _lcd(lcd)
{
}

void GeneratedUI_page1::show()
{
    _lcd.page(GeneratedUI_ID::Page1);
}

void GeneratedUI_page1::handleEvent(const TJC_Event& event)
{
}

GeneratedUI::GeneratedUI(TJC_Display& lcd)
    : _lcd(lcd),
      _controller(nullptr),
      page0(lcd),
      page1(lcd)
{
}

void GeneratedUI::update()
{
    processEvents();
}

void GeneratedUI::setController(GeneratedUIController* controller)
{
    _controller = controller;
}

void GeneratedUI::showPage(uint8_t pageId)
{
    _lcd.page(pageId);
}

void GeneratedUI::processEvents()
{
    _lcd.update();
    TJC_Event event;

    while (_lcd.read(event))
    {
        page0.handleEvent(event);
        page1.handleEvent(event);

        if (_controller)
        {
            _controller->onEvent(event);
            if (page0.title.isPress(event)) _controller->onTitlePress();
            if (page0.title.isRelease(event)) _controller->onTitleRelease();
            if (page0.value.isPress(event)) _controller->onValuePress();
            if (page0.value.isRelease(event)) _controller->onValueRelease();
            if (page0.progress.isPress(event)) _controller->onProgressPress();
            if (page0.progress.isRelease(event)) _controller->onProgressRelease();
            if (page0.start.isPress(event)) _controller->onStartPress();
            if (page0.start.isRelease(event)) _controller->onStartRelease();
            if (page0.slider.isPress(event)) _controller->onSliderPress();
            if (page0.slider.isRelease(event)) _controller->onSliderRelease();
            if (page0.bt0.isPress(event)) _controller->onBt0Press();
            if (page0.bt0.isRelease(event)) _controller->onBt0Release();
        }
    }
}
