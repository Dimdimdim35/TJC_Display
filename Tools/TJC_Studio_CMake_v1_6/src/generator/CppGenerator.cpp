#include "generator/CppGenerator.h"
#include <cctype>
#include <filesystem>
#include <fstream>
#include <string>

static std::string factoryMethod(ComponentType type)
{
    switch (type) {
        case ComponentType::Text: return "text";
        case ComponentType::Number: return "number";
        case ComponentType::Button: return "button";
        case ComponentType::DualButton: return "dualButton";
        case ComponentType::Slider: return "slider";
        case ComponentType::ProgressBar: return "progress";
        case ComponentType::Picture: return "picture";
        default: return "";
    }
}

static std::string makeIdName(std::string name)
{
    if (!name.empty()) name[0] = static_cast<char>(std::toupper(static_cast<unsigned char>(name[0])));
    return name;
}

void CppGenerator::generate(const Project& project, const std::string& className, const std::string& outputDir)
{
    std::filesystem::create_directories(outputDir);
    std::ofstream h(outputDir + "/" + className + ".h");
    std::ofstream cpp(outputDir + "/" + className + ".cpp");

    h << "// Generated by TJC_Studio v1.6.0\n";
    h << "#ifndef " << className << "_H\n#define " << className << "_H\n\n";
    h << "#include <TJC_Display.h>\n\n";

    h << "namespace " << className << "_ID\n{\n";
    for (const auto& page : project.pages)
        for (const auto& component : page.components)
            h << "    constexpr uint8_t " << makeIdName(component.cppName) << " = "
              << static_cast<unsigned int>(component.id) << ";\n";
    h << "}\n\n";

    for (const auto& page : project.pages) {
        std::string pageClass = className + "_" + page.cppName;
        h << "class " << pageClass << "\n{\npublic:\n";
        h << "    explicit " << pageClass << "(TJC_Display& lcd);\n\n";
        for (const auto& component : page.components)
            h << "    " << componentTypeToCppClass(component.type) << " " << component.cppName << ";\n";
        h << "};\n\n";
    }

    h << "class " << className << "\n{\npublic:\n";
    h << "    explicit " << className << "(TJC_Display& lcd);\n\n";
    for (const auto& page : project.pages)
        h << "    " << className << "_" << page.cppName << " " << page.cppName << ";\n";
    h << "};\n\n#endif // " << className << "_H\n";

    cpp << "// Generated by TJC_Studio v1.6.0\n";
    cpp << "#include \"" << className << ".h\"\n\n";

    for (const auto& page : project.pages) {
        std::string pageClass = className + "_" + page.cppName;
        cpp << pageClass << "::" << pageClass << "(TJC_Display& lcd)";
        if (!page.components.empty()) {
            cpp << "\n    : ";
            for (size_t i = 0; i < page.components.size(); ++i) {
                const auto& c = page.components[i];
                if (i > 0) cpp << ",\n      ";
                cpp << c.cppName << "(lcd." << factoryMethod(c.type)
                    << "(\"" << c.hmiName << "\", "
                    << className << "_ID::" << makeIdName(c.cppName) << "))";
            }
        }
        cpp << "\n{\n}\n\n";
    }

    cpp << className << "::" << className << "(TJC_Display& lcd)";
    if (!project.pages.empty()) {
        cpp << "\n    : ";
        for (size_t i = 0; i < project.pages.size(); ++i) {
            if (i > 0) cpp << ",\n      ";
            cpp << project.pages[i].cppName << "(lcd)";
        }
    }
    cpp << "\n{\n}\n";
}
